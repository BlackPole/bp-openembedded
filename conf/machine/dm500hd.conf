## conf/machine/vuuno.conf
```bitbake
#@TYPE: Machine
#@NAME: Vu+ Uno
#@DESCRIPTION: Machine configuration for the Vu+ Uno

UPDATE_DIR = "uno"

include vuxxo.inc

ENIGMA2_MACHINE_PLUGINS += "\
	enigma2-plugin-systemplugins-manualfancontrol \
	enigma2-plugin-systemplugins-fpgaupgrade \
	enigma2-plugin-systemplugins-remotecontrolcode \
"

MACHINE_FEATURES += "kernel26 alsa usbhost wifi nl80211"

# openpli specific features:
MACHINE_FEATURES += "32bpp hdtv switchoff lpcm textlcd dvbapi5 satscan dvb-c"

CHIPSET = "bcm7413"

MACHINE_KERNEL_PR = "r4"

PREFERRED_PROVIDER_virtual/satscanutils = "vuplus-blindscan-utils"
```
